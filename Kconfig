## Kconfig
```kconfig
menu "Scyan ZMK Display Module"

config LV_Z_MEM_POOL_SIZE
    default 4096 if ZMK_DISPLAY_STATUS_SCREEN_CUSTOM

choice SCYAN_ROTATION
    prompt "Status Screen Rotation"
    default SCYAN_ROTATION_90
    help
      Orientation transform angle for Corne vertical OLED displays.

config SCYAN_ROTATION_90
    bool "90 degrees (standard vertical Corne mounting)"

config SCYAN_ROTATION_270
    bool "270 degrees (counter-clockwise)"

config SCYAN_ROTATION_180
    bool "180 degrees (upside-down)"

config SCYAN_ROTATION_0
    bool "0 degrees (horizontal / no rotation)"

endchoice

config SCYAN_INVERT
    bool "Invert display colors"
    default y
    help
      Inverts monochrome pixels (swap black and white).

config SCYAN_IDLE_TIMEOUT_MS
    int "Idle screen timeout in milliseconds"
    default 10000
    help
      Duration of key inactivity in milliseconds before transitioning to the idle screen layout.

config SCYAN_USER_NAME
    string "Default branding user name"
    default "SCYAN"
    help
      Default text string rendered by branding widgets when no custom text is supplied.

config SCYAN_BONGO_TAP_MS
    int "Bongo Cat tap duration in milliseconds"
    default 60
    help
      Duration in milliseconds that Bongo Cat holds a paw down before returning to neutral.

config SCYAN_LEFT_IS_CENTRAL
    bool "Central split half is the left side"
    default y
    help
      Set to y if the Central (master) keyboard half is the left split part.
      Set to n if the Central half is the right split part.

DT_COMPAT_SCYAN_WIDGET_OUTPUT := scyan,widget-output
DT_COMPAT_SCYAN_WIDGET_BATTERY := scyan,widget-battery
DT_COMPAT_SCYAN_WIDGET_LAYER := scyan,widget-layer
DT_COMPAT_SCYAN_WIDGET_WPM := scyan,widget-wpm
DT_COMPAT_SCYAN_WIDGET_WPM_CHART := scyan,widget-wpm-chart
DT_COMPAT_SCYAN_WIDGET_BRANDING := scyan,widget-branding
DT_COMPAT_SCYAN_WIDGET_SPLIT := scyan,widget-split
DT_COMPAT_SCYAN_WIDGET_SCREENSAVER := scyan,widget-screensaver
DT_COMPAT_SCYAN_WIDGET_CAPS := scyan,widget-caps
DT_COMPAT_SCYAN_WIDGET_BONGO := scyan,widget-bongo
DT_COMPAT_SCYAN_WIDGET_LOOP := scyan,widget-loop
DT_COMPAT_SCYAN_WIDGET_TYPEWRITER := scyan,widget-typewriter
DT_COMPAT_SCYAN_WIDGET_KEYPRESS := scyan,widget-keypress

config SCYAN_WIDGET_OUTPUT
    bool
    default $(dt_compat_enabled,$(DT_COMPAT_SCYAN_WIDGET_OUTPUT))

config SCYAN_WIDGET_BATTERY
    bool
    default $(dt_compat_enabled,$(DT_COMPAT_SCYAN_WIDGET_BATTERY))

config SCYAN_WIDGET_LAYER
    bool
    default $(dt_compat_enabled,$(DT_COMPAT_SCYAN_WIDGET_LAYER))

config SCYAN_WIDGET_WPM
    bool
    default $(dt_compat_enabled,$(DT_COMPAT_SCYAN_WIDGET_WPM)) || $(dt_compat_enabled,$(DT_COMPAT_SCYAN_WIDGET_WPM_CHART))

config SCYAN_WIDGET_WPM_CHART
    bool
    default $(dt_compat_enabled,$(DT_COMPAT_SCYAN_WIDGET_WPM_CHART))

config SCYAN_WIDGET_BRANDING
    bool
    default $(dt_compat_enabled,$(DT_COMPAT_SCYAN_WIDGET_BRANDING))

config SCYAN_WIDGET_SPLIT
    bool
    default $(dt_compat_enabled,$(DT_COMPAT_SCYAN_WIDGET_SPLIT))

config SCYAN_WIDGET_SCREENSAVER
    bool
    default $(dt_compat_enabled,$(DT_COMPAT_SCYAN_WIDGET_SCREENSAVER))

config SCYAN_WIDGET_CAPS
    bool
    default $(dt_compat_enabled,$(DT_COMPAT_SCYAN_WIDGET_CAPS))

config SCYAN_WIDGET_BONGO
    bool
    default $(dt_compat_enabled,$(DT_COMPAT_SCYAN_WIDGET_BONGO))

config SCYAN_WIDGET_LOOP
    bool
    default $(dt_compat_enabled,$(DT_COMPAT_SCYAN_WIDGET_LOOP))

config SCYAN_WIDGET_TYPEWRITER
    bool
    default $(dt_compat_enabled,$(DT_COMPAT_SCYAN_WIDGET_TYPEWRITER))

config SCYAN_WIDGET_KEYPRESS
    bool
    default $(dt_compat_enabled,$(DT_COMPAT_SCYAN_WIDGET_KEYPRESS))

endmenu
```

## dts/bindings/display/scyan,display-layout.yaml
```yaml
# Copyright (c) 2026 Bruno Barcellos
# SPDX-License-Identifier: MIT

description: "Scyan OLED display layout root container"
compatible: "scyan,display-layout"

properties:
  display-name:
    type: string
    description: "Human-readable label for IDE preview"
  width:
    type: int
    default: 32
  height:
    type: int
    default: 128
  rotation:
    type: int
    default: 90
  invert:
    type: boolean
  idle-timeout-ms:
    type: int
    default: 10000
  idle-layout:
    type: phandle
    required: false
    description: "Phandle to the corresponding idle scyan,display-layout node"
```

## dts/bindings/display/scyan,layouts.yaml
```yaml
# Copyright (c) 2026 Bruno Barcellos
# SPDX-License-Identifier: MIT

description: "Scyan display layouts root container"
compatible: "scyan,layouts"
```

## dts/bindings/widgets/scyan,widget-caps.yaml
```yaml
# Copyright (c) 2026 Bruno Barcellos
# SPDX-License-Identifier: MIT

description: "Scyan widget: caps lock"
compatible: "scyan,widget-caps"

properties:
  x: { type: int, required: true }
  y: { type: int, required: true }
  width: { type: int, required: true }
  height: { type: int, required: true }
  enabled: { type: int, default: 1 }
  mode: { type: int, default: 0 }
  param1: { type: int, default: 0 }
  param2: { type: int, default: 0 }
  param3: { type: int, default: 0 }
  symbols: { type: array, required: false }
  text-entries: { type: string-array, required: false }
  custom-text: { type: string, required: false }
  symbol-id: { type: int, default: 0 }
```
